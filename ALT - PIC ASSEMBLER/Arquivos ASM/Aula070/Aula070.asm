	TITLE		"AULA70 - LEITURA/ESCRITA NA MEMÓRIA EEPROM POR INTERRUPÇÃO"
	
	PROCESSOR	16F84A
	#INCLUDE	<P16F84A.INC>
	__CONFIG 	_XT_OSC & _CP_OFF & _WDT_OFF & _PWRTE_ON

;++++++++++++++++++++++++++++++++++++++++++++++++++++++++++++++++++++++++++++++

	;REGISTRADORES BANCO 0
	#DEFINE		BOTAO			PORTA, RA0			;BOTÃO DE INTERRUPÇÃO
	#DEFINE		LED				PORTA, RA1			;LED DA INTERRUPÇÃO
	
	;REGISTRADORES BANCO 1
	#DEFINE		INT_GLOBAL		INTCON, GIE			;CHAVE GERAL DAS INTERRUPÇÕES
	#DEFINE		INT_EEPROM		INTCON, EEIE		;CHAVE DA INTERRUPÇÃO DA EEPROM
	#DEFINE		FLAG			EECON1, EEIF		;FLAG DA INTERRUPÇÃO DA EEPROM
	
	;REGISTRADORES DE USO GERAL
	#DEFINE		BANCO0		BCF		STATUS, RP0		;BIT 5, (0) = BANCO 0
	#DEFINE		BANCO1		BSF		STATUS, RP0		;BIT 5, (1) = BANCO 1
	
;++++++++++++++++++++++++++++++++++++++++++++++++++++++++++++++++++++++++++++++
	CBLOCK		0X0C
	ENDERECO	
	VALOR
	TEMPO1
	TEMPO2
	TEMPO3
	ENDC		
	
;++++++++++++++++++++++++++++++++++++++++++++++++++++++++++++++++++++++++++++++

	ORG			0X00
	GOTO 		INICIO
	
	ORG			0X04
	
	BSF			LED
	CALL		DELAY_500MS
	BCF			LED
	MOVF		ENDERECO, W
	MOVWF		EEADR
	
	BANCO1
	BCF			FLAG
	BCF			EECON1, WREN				;DESABILITA A ESCRITA
	BSF			EECON1, RD					;HABILITA A LEITURA
	BANCO0
	MOVF		EEDATA, W
	MOVWF		PORTB
	
	RETFIE
	
;++++++++++++++++++++++++++++++++++++++++++++++++++++++++++++++++++++++++++++++

INICIO:
	BANCO1
	MOVLW		B'11111101'
	MOVWF		TRISA						;APENAS RA1 COMO SAÍDA
	CLRF		TRISB
	BANCO0
	CLRF		PORTB
	BSF			INT_EEPROM
	CLRF		ENDERECO
	MOVLW		D'10'
	MOVWF		VALOR
	
LOOP:
	BANCO0
	BTFSC		BOTAO
	GOTO		$ -1
	CALL		DELAY_500MS
	
	MOVF		ENDERECO, W
	MOVWF		EEADR
	MOVF		VALOR, W
	MOVWF		EEDATA
	
	BANCO1
	BCF			INT_GLOBAL
	BSF			EECON1, WREN				;HABILITA ESCRITA
	MOVLW		0X55
	MOVWF		EECON2
	MOVLW		0XAA
	MOVWF		EECON2
	BSF			EECON1, WR
	CALL		DELAY_500MS
	BANCO0
	BSF			INT_GLOBAL
	
	INCF		ENDERECO
	INCF		VALOR
	GOTO		LOOP
	
			
	
	
DELAY_500MS:									;APROXIMADAMENTE 500MS
	MOVLW		D'249'
	MOVWF		TEMPO1
M2:
	MOVLW		D'250'
	MOVWF		TEMPO2
M1:	
	NOP
	NOP
	NOP
	NOP
	NOP
	
	DECFSZ		TEMPO2
	GOTO		M1
	
	DECFSZ		TEMPO1
	GOTO		M2
	
	RETURN
		
	END
	
;++++++++++++++++++++++++++++++++++++++++++++++++++++++++++++++++++++++++++++++
