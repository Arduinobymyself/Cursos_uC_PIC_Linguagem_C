	TITLE		"AULA60 - WWHATCH DOG TIMER WDT"
	;OS LEDS EM RB7 E RB6 PISCAM ALTERNADAMENTE A CADA 500MS
	PROCESSOR	16F84A
	#INCLUDE	<P16F84A.INC>
	__CONFIG 	_XT_OSC & _CP_OFF & _WDT_ON & _PWRTE_ON

;++++++++++++++++++++++++++++++++++++++++++++++++++++++++++++++++++++++++++++++

	;REGISTRADORES BANCO 0
	;#DEFINE		FLAG		INTCON, T0IF			; BIT 2, FLAG OVERFLOW (1) DA INTERRUPÇÃO POR TIMER 0
	;#DEFINE		INT_GLOBAL	INTCON, GIE				; BIT 7, (1) HABILITA INTERRUPÇÃO GLOBAL
	;#DEFINE		INT_TMR0	INTCON,	T0IE			; BIT 5, (1) HABILITA INTERRUPÇÃO POR TIMER 0
	
	;REGISTRADORES BANCO 1
	;#DEFINE		INC_TIMER0	OPTION_REG, T0CS		; BIT 5, TMR0 POR CICLO DE MÁQUINA (0) OU RA4 (1)
	;#DEFINE		BORDA		OPTION_REG, T0SE		; BIT 4, BORDA DESCIDA (1) OU BORDA SUBIDA (0)
	#DEFINE		PRESCALER	OPTION_REG, PSA			; BIT 3, PRESCALER PARA O TMR0 (0) OU WDT (1)
	#DEFINE		BIT_PS2		OPTION_REG, PS2			; BIT 2, <2:0>, TAXA DO PRESCALER
	#DEFINE		BIT_PS1		OPTION_REG, PS1			; BIT 1
	#DEFINE		BIT_PS0		OPTION_REG, PS0			; BIT 0
	
	;GERAL
	#DEFINE		BANCO0		BCF		STATUS, RP0		;BIT 5, (0) = BANCO 0
	#DEFINE		BANCO1		BSF		STATUS, RP0		;BIT 5, (1) = BANCO 1
	
;++++++++++++++++++++++++++++++++++++++++++++++++++++++++++++++++++++++++++++++

	TEMPO1		EQU			0X0C
	TEMPO2		EQU			0X0D
	
;++++++++++++++++++++++++++++++++++++++++++++++++++++++++++++++++++++++++++++++

	ORG			0X00
	GOTO 		INICIO
	
	ORG			0X04
	RETFIE
	
;++++++++++++++++++++++++++++++++++++++++++++++++++++++++++++++++++++++++++++++

INICIO:
	
	BANCO1									;PODERIA USAR: BANKSEL TRISB
	CLRF		TRISB						;PORT B COMO SAÍDA
	
	;BCF			INC_TIMER0					;INCREMENTO DO TIMER 0 VIA OSCILADOR (T0CS<5>)
	;BSF			BORDA						;BORDA DE DESCIDA HIGH-TO-LOW
	BSF			PRESCALER					;PRESCALER PARA WDT (PSA<3>)
	BSF			BIT_PS2						;PS<2:0> PRESCALER 1:32 (32 * 18MS = 576MS)
	BCF			BIT_PS1						
	BSF			BIT_PS0						
	
	BANCO0									;PODERIA USAR: BANKSEL PORTB
	CLRF		PORTB



LED1:
	BSF			PORTB, RB7
	BCF			PORTB, RB6
	CALL		DELAY_500
	CLRWDT									;PARA EFEITO DE TESTES, COMENTE ESTA LINHA E VEJA O uC RESETANDO A CADA 576MS									
	GOTO		LED2					
	
LED2:
	BSF			PORTB, RB6
	BCF			PORTB, RB7
	CALL		DELAY_500
	CLRWDT
	GOTO		LED1	


	
DELAY_500:									;APROXIMADAMENTE 500MS
	MOVLW		D'249'
	MOVWF		TEMPO1
M2
	MOVLW		D'250'
	MOVWF		TEMPO2
M1	
	NOP
	NOP
	NOP
	NOP
	NOP
	
	DECFSZ		TEMPO2
	GOTO		M1
	
	DECFSZ		TEMPO1
	GOTO		M2
	
	RETURN
		
	END
	
;++++++++++++++++++++++++++++++++++++++++++++++++++++++++++++++++++++++++++++++
