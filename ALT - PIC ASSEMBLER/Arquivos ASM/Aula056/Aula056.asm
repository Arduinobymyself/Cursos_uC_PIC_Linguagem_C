	TITLE		"AULA56- INCREMENTO DO TIMER 0 VIA RA4"
	;INVERTE O PORT B A CADA 5 PRESSIONAMENTOS NO BOTÃO EM RA4
	PROCESSOR	16F84A
	#INCLUDE	<P16F84A.INC>
	__CONFIG 	_XT_OSC & _CP_OFF & _WDT_OFF & _PWRTE_ON

;++++++++++++++++++++++++++++++++++++++++++++++++++++++++++++++++++++++++++++++

	;REGISTRADORES BANCO 0
	#DEFINE		FLAG		INTCON, T0IF			; BIT 2, FLAG OVERFLOW (1) DA INTERRUPÇÃO POR TMR0
	
	;REGISTRADORES BANCO 1
	#DEFINE		INC_TIMER0	OPTION_REG, T0CS		; BIT 5, TMR0 POR CICLO DE MÁQUINA (0) OU RA4 (1)
	#DEFINE		BORDA		OPTION_REG, T0SE		; BIT 4, BORDA DESCIDA (1) OU BORDA SUBIDA (0)
	#DEFINE		PRESCALER	OPTION_REG, PSA			; BIT 3, PRESCALER PARA O TMR0 (0) OU WDT (1)
	#DEFINE		BIT_PS2		OPTION_REG, PS2			; BIT 2, <2:0>, TAXA DO PRESCALER
	#DEFINE		BIT_PS1		OPTION_REG, PS1			; BIT 1
	#DEFINE		BIT_PS0		OPTION_REG, PS0			; BIT 0
	
	;GERAL
	#DEFINE		BANCO0		BCF		STATUS, RP0		;BIT 5, (0) = BANCO 0
	#DEFINE		BANCO1		BSF		STATUS, RP0		;BIT 5, (1) = BANCO 1
	
;++++++++++++++++++++++++++++++++++++++++++++++++++++++++++++++++++++++++++++++



;++++++++++++++++++++++++++++++++++++++++++++++++++++++++++++++++++++++++++++++

	ORG			0X00
	GOTO 		INICIO
	
	ORG			0X04
	RETFIE
	
;++++++++++++++++++++++++++++++++++++++++++++++++++++++++++++++++++++++++++++++

INICIO:
	
	BANCO1									;PODERIA USAR: BANKSEL TRISB
	CLRF		TRISB						;PORT B COMO SAÍDA
	MOVLW		0XFF
	MOVWF		TRISA						;PORT A COMO ENTRADA
	CLRF		INTCON						;INICIA/LIMPA TODAS AS INTERRUPÇÕES E FLAGS
	
	BSF			INC_TIMER0					;INCREMENTO DO TIMER 0 VIA RA4 (T0CS<5>)
	BSF			BORDA						;BORDA DE DESCIDA HIGH-TO-LOW
	BSF			PRESCALER					;PRESCALER PARA WDT (PSA<3>)
	BCF			BIT_PS2						;PS<2:0> PRESCALER 1:1
	BCF			BIT_PS1						;COMO O PRESCALER ESTA PARA WDT E O WDT ESTÁ DESATIVADO VIA FUSEBIT
	BCF			BIT_PS0						;TANTO FAZ OS BITS PS<2:0>
	
	BANCO0									;PODERIA USAR: BANKSEL PORTB
	CLRF		PORTB
	CLRF		TMR0


LOOP:
	BCF			FLAG						;APAGA A FLAG
	MOVLW		D'251'						
	MOVWF		TMR0						;TMR0 = 251, CONTARA ATÉ 256 OU SEJA 5
TESTA:
	BTFSS		FLAG						;TESTA A FLAG, SE HOUVE ESTOURO
	GOTO		TESTA						;NÃO, CONTINUA A TESTAR A FLAG
	COMF		PORTB						;SIM, INVERTE O ESTADO DO PORT B
	GOTO		LOOP						;EXECUTA NOVAMENTE EM LOOOP

		
	END
	
;++++++++++++++++++++++++++++++++++++++++++++++++++++++++++++++++++++++++++++++
