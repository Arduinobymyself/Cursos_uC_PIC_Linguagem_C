	TITLE		"AULA59- INCREMENTO POR TIMER 0"
	;INVERTE O PORT B A CADA 500MS
	PROCESSOR	16F84A
	#INCLUDE	<P16F84A.INC>
	__CONFIG 	_XT_OSC & _CP_OFF & _WDT_OFF & _PWRTE_ON

;++++++++++++++++++++++++++++++++++++++++++++++++++++++++++++++++++++++++++++++

	;REGISTRADORES BANCO 0
	#DEFINE		FLAG		INTCON, T0IF			; BIT 2, FLAG OVERFLOW (1) DA INTERRUPÇÃO POR TIMER 0
	#DEFINE		INT_GLOBAL	INTCON, GIE				; BIT 7, (1) HABILITA INTERRUPÇÃO GLOBAL
	#DEFINE		INT_TMR0	INTCON,	T0IE			; BIT 5, (1) HABILITA INTERRUPÇÃO POR TIMER 0
	
	;REGISTRADORES BANCO 1
	#DEFINE		INC_TIMER0	OPTION_REG, T0CS		; BIT 5, TMR0 POR CICLO DE MÁQUINA (0) OU RA4 (1)
	#DEFINE		BORDA		OPTION_REG, T0SE		; BIT 4, BORDA DESCIDA (1) OU BORDA SUBIDA (0)
	#DEFINE		PRESCALER	OPTION_REG, PSA			; BIT 3, PRESCALER PARA O TMR0 (0) OU WDT (1)
	#DEFINE		BIT_PS2		OPTION_REG, PS2			; BIT 2, <2:0>, TAXA DO PRESCALER
	#DEFINE		BIT_PS1		OPTION_REG, PS1			; BIT 1
	#DEFINE		BIT_PS0		OPTION_REG, PS0			; BIT 0
	
	;GERAL
	#DEFINE		BANCO0		BCF		STATUS, RP0		;BIT 5, (0) = BANCO 0
	#DEFINE		BANCO1		BSF		STATUS, RP0		;BIT 5, (1) = BANCO 1
	
;++++++++++++++++++++++++++++++++++++++++++++++++++++++++++++++++++++++++++++++

	TEMPO		EQU			0X0C

;++++++++++++++++++++++++++++++++++++++++++++++++++++++++++++++++++++++++++++++

	ORG			0X00
	GOTO 		INICIO
	
	ORG			0X04
	
	MOVLW		D'8'						
	MOVWF		TEMPO						;CARREGA REGISTRADOR AUXILIAR DE TEMPORIZAÇÃO
M2:
	BCF			FLAG						;LIMPA FLAG T0IF
	MOVLW		D'12'
	MOVWF		TMR0						;INICIA REGISTRADOR TMR0
M1:
	BTFSS		FLAG						;TESTA FLAG SE HOUVE ESTOURO DO TIMER 0
	GOTO		M1							;NÃO, VOLTA A TESTAR A FLAG
	DECFSZ		TEMPO						;SIM, DECREMENTA REGISTRADOR AUXILIAR DE TEMPORIZAÇÃO E TESTA SE CHEGOU A ZERO
	GOTO		M2							;NÃO, VAOLTA A CONTAR	
	COMF		PORTB						;SIM, INVERTE O PORT B
	
	RETFIE
	
;++++++++++++++++++++++++++++++++++++++++++++++++++++++++++++++++++++++++++++++

INICIO:
	
	BANCO1									;PODERIA USAR: BANKSEL TRISB
	CLRF		TRISB						;PORT B COMO SAÍDA
	
	BCF			INC_TIMER0					;INCREMENTO DO TIMER 0 VIA OSCILADOR (T0CS<5>)
	BSF			BORDA						;BORDA DE DESCIDA HIGH-TO-LOW
	BCF			PRESCALER					;PRESCALER PARA TMR0 (PSA<3>)
	BSF			BIT_PS2						;PS<2:0> PRESCALER 1:256
	BSF			BIT_PS1						
	BSF			BIT_PS0						
	
	BANCO0									;PODERIA USAR: BANKSEL PORTB
	CLRF		PORTB
	BSF			INT_GLOBAL					;HABILITA INTERRUPÇÃO GLOBAL
	BSF			INT_TMR0					;HABILITA INTERRUPÇÃO POR TMR0
	CLRF		TMR0


LOOP:
	GOTO		LOOP						;EXECUTA NOVAMENTE EM LOOOP

		
	END
	
;++++++++++++++++++++++++++++++++++++++++++++++++++++++++++++++++++++++++++++++
