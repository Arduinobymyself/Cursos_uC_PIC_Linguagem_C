	TITLE		"AULA66 - ESCRITA NA MEMÓRIA EEPROM"
	
	PROCESSOR	16F84A
	#INCLUDE	<P16F84A.INC>
	__CONFIG 	_XT_OSC & _CP_OFF & _WDT_OFF & _PWRTE_ON

;++++++++++++++++++++++++++++++++++++++++++++++++++++++++++++++++++++++++++++++

	;REGISTRADORES BANCO 0
	;#DEFINE		FLAG		INTCON, T0IF			; BIT 2, FLAG OVERFLOW (1) DA INTERRUPÇÃO POR TIMER 0
	#DEFINE			INT_GLOBAL	INTCON, GIE				; BIT 7, (1) HABILITA INTERRUPÇÃO GLOBAL
	;#DEFINE		INT_TMR0	INTCON,	T0IE			; BIT 5, (1) HABILITA INTERRUPÇÃO POR TIMER 0
	
	;REGISTRADORES BANCO 1
	;#DEFINE		INC_TIMER0	OPTION_REG, T0CS		; BIT 5, TMR0 POR CICLO DE MÁQUINA (0) OU RA4 (1)
	;#DEFINE		BORDA		OPTION_REG, T0SE		; BIT 4, BORDA DESCIDA (1) OU BORDA SUBIDA (0)
	;#DEFINE		PRESCALER	OPTION_REG, PSA			; BIT 3, PRESCALER PARA O TMR0 (0) OU WDT (1)
	;#DEFINE		BIT_PS2		OPTION_REG, PS2			; BIT 2, <2:0>, TAXA DO PRESCALER
	;#DEFINE		BIT_PS1		OPTION_REG, PS1			; BIT 1
	;#DEFINE		BIT_PS0		OPTION_REG, PS0			; BIT 0
	
	;GERAL
	#DEFINE		BANCO0		BCF		STATUS, RP0		;BIT 5, (0) = BANCO 0
	#DEFINE		BANCO1		BSF		STATUS, RP0		;BIT 5, (1) = BANCO 1
	
;++++++++++++++++++++++++++++++++++++++++++++++++++++++++++++++++++++++++++++++
	CBLOCK		0X0C
	ENDERECO	
	TEMPO1		
	TEMPO2
	TEMPO3
	ENDC		
	
;++++++++++++++++++++++++++++++++++++++++++++++++++++++++++++++++++++++++++++++

	ORG			0X00
	GOTO 		INICIO
	
	ORG			0X04
	RETFIE
	
;++++++++++++++++++++++++++++++++++++++++++++++++++++++++++++++++++++++++++++++

INICIO:
	
	BANCO0
	CLRF		ENDERECO					;ENDERECO = 0X00
	
LOOP:
	MOVF		ENDERECO, W					;W = ENDERECO
	MOVWF		EEADR						;EEADR = W (ENDERECO)
	MOVLW		0XA0						;W = 0XAB
	MOVWF		EEDATA						;EEDATA = W (0XAB)
	
	BANCO1
	BCF			INT_GLOBAL					;DESLIGA CHAVE GERAL DE INTERRUPÇÕES DURANTE A ESCRITA
	BSF			EECON1, WREN				;LIGA A CHAVE DE ESCRITA NA EEPROM
	MOVLW		0X55						;W = 0X55
	MOVWF		EECON2						;EECON2 = 0X55
	MOVLW		0XAA						;W = 0XAA
	MOVWF		EECON2						;EECON2 = 0XAA
	BSF			EECON1, WR					;INICIA A ESCRITA NA EEPROM
	BSF			INT_GLOBAL					;LIGA A CHAVE GERAL DE INTERRUPÇÕES
	CALL		DELAY_5MS
	
	
	
	INCF		ENDERECO					;INCREMENTA ENDERECO
	BANCO0
	GOTO		LOOP						;NOVA ESCRITA NO NOVO ENDERECO


	
DELAY_5MS:									;APROXIMADAMENTE 500MS
	MOVLW		D'5'
	MOVWF		TEMPO1
M3:
	MOVLW		D'250'
	MOVWF		TEMPO2
M2:
	MOVWF		TEMPO3
M1:	
	DECFSZ		TEMPO3	
	GOTO		M1
	
	DECFSZ		TEMPO2
	GOTO		M2
	
	DECFSZ		TEMPO1
	GOTO		M3
	
	RETURN
		
	END
	
;++++++++++++++++++++++++++++++++++++++++++++++++++++++++++++++++++++++++++++++
