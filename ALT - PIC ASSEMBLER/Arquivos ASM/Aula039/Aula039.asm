	TITLE		"AULA039 - ENTRADA DE DADOS - DOIS BOTÕES LIGA E DESLIGA - RESISTORES DE PULL-UPN"
	PROCESSOR	16F84A
	#INCLUDE	<P16F84A.INC>
	__CONFIG 	_XT_OSC & _CP_OFF & _WDT_OFF & _PWRTE_ON

;++++++++++++++++++++++++++++++++++++++++++++++++++++++++++++++++++++++++++++++

	#DEFINE		BOTAO1		PORTB, RB0
	#DEFINE		BOTAO2		PORTB, RB1
	#DEFINE		LED			PORTB, RB7
	#DEFINE		PULL_UP		OPTION_REG, 7
	TEMPO1		EQU			0X0C
	TEMPO2		EQU			0X0D

;++++++++++++++++++++++++++++++++++++++++++++++++++++++++++++++++++++++++++++++

	ORG			0X00
	GOTO 		INICIO
	
	ORG			0X04
	RETFIE
	
;++++++++++++++++++++++++++++++++++++++++++++++++++++++++++++++++++++++++++++++

INICIO:
	
	BANKSEL		TRISB
	MOVLW		B'01111111'					;APENAS RB7 COMO SAÍDA, RESTANTE COMO ENTRADA
	MOVWF		TRISB
	BCF 		PULL_UP						;ATIVA PULL-UP PARA OS BOTÕES
	
	BANKSEL		PORTB
	CLRF		PORTB

VERIFICA_TUDO:

VERIFICA_BOTAO1:
	BTFSC		BOTAO1						;BOTAO ACIONADO (0) PARA RESISTORES DE PULL-UP
	GOTO		VERIFICA_BOTAO2				;NÃO, MANTÉM CONDIÇÃO ATUAL, VOLTA A TESTAR
	BSF			LED
	GOTO		DEBOUCE						;SIM, ALTERNA ESTADO DO LED

VERIFICA_BOTAO2:
	BTFSC		BOTAO2						;BOTAO ACIONADO (0) PARA RESISTORES DE PULL-UP
	GOTO		VERIFICA_BOTAO1				;NÃO, MANTÉM CONDIÇÃO ATUAL, VOLTA A TESTAR
	BCF			LED
	GOTO		DEBOUCE						;SIM, ALTERNA ESTADO DO LED
	

	
DEBOUCE:									;GERA UM TEMPO PARA O DEBOUCE DO BOTÃO
	MOVLW		D'255'
	MOVWF		TEMPO1
M1:
	MOVLW		D'255'
	MOVWF		TEMPO2
M2:
	NOP
	DECFSZ		TEMPO2
	GOTO		M2
	
	DECFSZ		TEMPO1
	GOTO		M1
	
	GOTO 		VERIFICA_TUDO
	
	END
	
;++++++++++++++++++++++++++++++++++++++++++++++++++++++++++++++++++++++++++++++
