	TITLE		"AULA50 - INTERRUPÇÃO EXTERNA POR RB E POR RB0"
	PROCESSOR	16F84A
	#INCLUDE	<P16F84A.INC>
	__CONFIG 	_XT_OSC & _CP_OFF & _WDT_OFF & _PWRTE_ON

;++++++++++++++++++++++++++++++++++++++++++++++++++++++++++++++++++++++++++++++

	;REGISTRADORES BANCO 0
	#DEFINE		CH_GERAL	INTCON, GIE				;BIT 7  HABILITA INTERRUPÇÃO GERAL
	#DEFINE		INT_RB		INTCON, RBIE			;BIT 3  HABILITA INTERRUPÇÃO POR RB4 A RB7
	#DEFINE		INT_RB0		INTCON, INTE			;BIT 5  HABILITA INTERRUPÇÃO POR RB0
	#DEFINE		FLAG_RB		INTCON, RBIF			;BIT 0
	#DEFINE		FLAG_RB0	INTCON, INTF			;BIT 2
	;REGISTRADORES BANCO 1

	;GERAL
	#DEFINE		BANCO0		BCF		STATUS, RP0		;BIT 5
	#DEFINE		BANCO1		BSF		STATUS, RP0		;BIT 5
	#DEFINE		LED1		PORTB, RB1
	#DEFINE		LED2		PORTB, RB2
	#DEFINE		LED_RB		PORTA, RA1				;LED DA INTERRUPÇÃO RB
	#DEFINE		LED_RB0		PORTA, RA2				;LED DA INTERRUPÇÃO RB0
	
;++++++++++++++++++++++++++++++++++++++++++++++++++++++++++++++++++++++++++++++

	TEMPO1		EQU			0X0C
	TEMPO2		EQU			0X0D

;++++++++++++++++++++++++++++++++++++++++++++++++++++++++++++++++++++++++++++++

	ORG			0X00
	GOTO 		INICIO
	
	ORG			0X04
	BCF			LED1
	BCF			LED2
	BTFSS		FLAG_RB0
	BTFSS		FLAG_RB
	GOTO		INTERRUP_RB0
	GOTO		INTERRUP_RB
	
INTERRUP_RB0:
	BSF			LED_RB0
	BCF			LED_RB
	GOTO		ROTINA
INTERRUP_RB:
	BSF			LED_RB
	BCF			LED_RB0
	GOTO		ROTINA

ROTINA:
	CALL		DELAY
	CALL		DELAY
	BCF			LED_RB
	BCF			FLAG_RB
	BCF			LED_RB0
	BCF			FLAG_RB0

	RETFIE
	
;++++++++++++++++++++++++++++++++++++++++++++++++++++++++++++++++++++++++++++++

INICIO:
	
	BANCO1									;PODERIA USAR: BANKSEL TRISB
	MOVLW		B'11111001'					;RB7 A RB4 E RB0 COMO ENTRADA
	MOVWF		TRISB
	MOVLW		B'00000000'					;CONFIGURA PORT A COMO SAÍDA
	MOVWF		TRISA						
	CLRF		INTCON						;INICIA/LIMPA TODAS AS INTERRUPÇÕES E FLAGS
	
	BANCO0									;PODERIA USAR: BANKSEL PORTB
	CLRF		PORTB
	BSF			CH_GERAL					;LIGA A CHAVE GERAL
	BSF			INT_RB						;LIGA A CHAVE DA INTERRUPÇÃO RB
	BSF			INT_RB0						;LIGA A CHAVE DA INTERRUPÇÃO RB0


L1:
	BSF			LED1
	BCF			LED2
	CALL		DELAY
	GOTO		L2
	
L2:
	BCF			LED1
	BSF			LED2
	CALL		DELAY
	GOTO		L1


DELAY:
	MOVLW		D'249'
	MOVWF		TEMPO1
M2:	
	MOVLW		D'251'
	MOVWF		TEMPO2
	
M1:
	NOP
	NOP
	NOP
	NOP
	NOP
	
	DECFSZ		TEMPO2
	GOTO 		M1
	
	DECFSZ		TEMPO1
	GOTO 		M2	
	
	RETURN

	
	END
	
;++++++++++++++++++++++++++++++++++++++++++++++++++++++++++++++++++++++++++++++
